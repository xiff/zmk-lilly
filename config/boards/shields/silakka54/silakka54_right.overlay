/*
 * Copyright (c) 2024 The ZMK Contributors
 *
 * SPDX-License-Identifier: MIT
 */

#include "silakka54.dtsi"

&default_transform {
    col-offset = <6>;
};

&kscan0 {
    // Column pins for RIGHT side - GP7, GP8, GP9, GP10, GP11, GP12
    col-gpios
        = <&pro_micro 7 GPIO_ACTIVE_HIGH>
        , <&pro_micro 8 GPIO_ACTIVE_HIGH>
        , <&pro_micro 9 GPIO_ACTIVE_HIGH>
        , <&pro_micro 10 GPIO_ACTIVE_HIGH>
        , <&pro_micro 11 GPIO_ACTIVE_HIGH>
        , <&pro_micro 12 GPIO_ACTIVE_HIGH>
        ;
};
